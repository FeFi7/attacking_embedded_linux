## meta-attacking_embedded_linux/conf/layer.conf
```bitbake
# We have a conf and classes directory, add to BBPATH
BBPATH .= ":${LAYERDIR}"

# We have recipes-* directories, add to BBFILES
BBFILES += "${LAYERDIR}/recipes-*/*/*.bb \
            ${LAYERDIR}/recipes-*/*/*.bbappend"

BBFILE_COLLECTIONS += "meta-attacking_embedded_linux"
BBFILE_PATTERN_meta-attacking_embedded_linux = "^${LAYERDIR}/"
BBFILE_PRIORITY_meta-attacking_embedded_linux = "6"

LAYERDEPENDS_meta-attacking_embedded_linux = "core"
LAYERSERIES_COMPAT_meta-attacking_embedded_linux = "kirkstone"
```
